## Documentation/devicetree/bindings/thermal/qcom-bcl-legacy.txt
```
===============================================================================
BCL PMIC Peripheral driver for legacy PMIC peripherals:
===============================================================================
Qualcomm Technologies, Inc's PMIC has battery current limiting peripheral, which can monitor for
high battery current and low battery voltage in the hardware. The BCL
peripheral driver interacts with the PMIC peripheral using the SPMI driver
interface. The hardware can take threshold for notifying for high battery
current or low battery voltage events.

Required Parameters:
- compatible: must be
	'qcom,msm-bcl' for bcl peripheral without LMH DCVSh
- reg: <a b> where 'a' is the starting register address of the PMIC
	peripheral and 'b' is the size of the peripheral address space.
	If the BCL inhibit current derating feature is enabled, this must also
	have the PON spare registers as well. Example: <a b c d> where
	c is the first PON spare register that will be written and d is the
	size of the registers space needed to be written.
- reg-names: a list of names of the registers corresponding to the reg
	property. The fuel gauge peripheral should be "fg_user_adc", the
	PON spare should be "pon_spare".
- interrupts: <a b c> Where 'a' is the SLAVE ID of the PMIC, 'b' is
		the peripheral ID and 'c' is the interrupt number in PMIC.
- interrupt-names: user defined names for the interrupts. These
		interrupt names will be used by the drivers to identify the
		interrupts, instead of specifying the ID's. bcl driver will
		accept these two standard interrupts.
		"bcl-low-vbat"
		"bcl-high-ibat"

- qcom,vbat-scaling-factor: The scaling factor to be used for converting
		the raw vbat ADC value to milli-volt.
- qcom,vbat-gain-numerator: The numerator of the vbat gain correction factor.
- qcom,vbat-gain-denominator: The denominator of the vbat gain correction
		factor.
- qcom,ibat-scaling-factor: The scaling factor to be used for converting
		the raw ibat ADC value to micro-amps.
- qcom,ibat-gain-numerator: The numerator of the ibat gain correction factor.
- qcom,ibat-gain-denominator: The denominator of the ibat gain correction
		factor.
- qcom,ibat-offset-numerator: The numerator of the ibat offset correction
		factor.
- qcom,ibat-offset-denominator: The denominator of the ibat offset
		correction factor.


Optional Parameters:
- qcom,inhibit-derating-ua: The amount that the bcl current high trip threshold
		should be lowered by when the bcl peripheral is operating in a
		dead time.

		bcl@4200 {
			compatible = "qcom,msm-bcl";
			reg = <0x4200 0xff>,
				<0x88e 0x2>;
			reg-names = "fg_user_adc",
					"pon_spare";
			interrupts = <0x2 0x42 0x0 IRQ_TYPE_NONE>,
					<0x2 0x42 0x1 IRQ_TYPE_NONE>;
			interrupt-names = "bcl-high-ibat",
						"bcl-low-vbat",
			qcom,vbat-scaling-factor = <39>;
			qcom,vbat-gain-numerator = <1>;
			qcom,vbat-gain-denominator = <32>;
			qcom,ibat-scaling-factor = <39>;
			qcom,ibat-gain-numerator = <1>;
			qcom,ibat-gain-denominator = <32>;
			qcom,ibat-offset-numerator = <12>;
			qcom,ibat-offset-denominator = <10>;
		};
```

## Kconfig
```kconfig
comment "Qualcomm Atheros Prima WLAN module"

if CFG80211 && WCNSS_CORE_PRONTO

config PRIMA_WLAN
	tristate "Qualcomm Atheros Prima WLAN module"
	default n
	help
	  Add support for the Qualcomm Atheros Prima WLAN module

config PRONTO_WLAN
	tristate "Qualcomm Atheros Pronto WLAN module"
	default n
	help
	  Add support for the Qualcomm Atheros Pronto WLAN module

endif # CFG80211 && WCNSS_CORE_PRONTO
```

## drivers/input/fingerprint/Kconfig
```kconfig
config INPUT_FINGERPRINT
	tristate "Fingerprint driver support"
	help
	  Say Y here to enable fingerprint driver support.

if MACH_XIAOMI_C6
source "drivers/input/fingerprint/goodix_mido/Kconfig"
source "drivers/input/fingerprint/fpc_mido/Kconfig"
endif
```

## drivers/input/fingerprint/fpc_mido/Kconfig
```kconfig
config FINGERPRINT_FPC1020_C6
	tristate "FingerPrint Cards fingerprint driver support"
	depends on INPUT_FINGERPRINT
	help
	  Say Y here to enable fpc fingerprint driver support!
```

## drivers/input/fingerprint/goodix_mido/Kconfig
```kconfig
config FINGERPRINT_GOODIX_GF3208_C6
	tristate "Goodix GF3208 fingerprint driver support"
	depends on INPUT_FINGERPRINT
	help
	  Say Y here to enable goodix fingerprint driver support!
```

## drivers/input/touchscreen/gt9xx_v2.4/Kconfig
```kconfig
#
# Goodix GT9xx Touchscreen driver
#
config TOUCHSCREEN_GT9XX_v24
	bool "Goodix touchpanel GT9xx series"
	depends on I2C
	help
	  Enable this for support Goodix GT9xx_v24 driver.

	  Say Y here if you have a Goodix GT9xx touchscreen
	  controller.

          If unsure, say N.

config TOUCHSCREEN_GT9XX_v24_UPDATE
	tristate "Goodix GT9xx touch controller auto update support"
	depends on TOUCHSCREEN_GT9XX_v24
	help
	  Enable this for support firmware update.

	  Say Y here if you want update touch controller
	  firmware.

	  If unsure, say N.

config TOUCHSCREEN_GT9XX_v24_TOOL
	tristate "Goodix GT9xx Tools for debuging"
	depends on TOUCHSCREEN_GT9XX_v24
	help
	  This implement interface support for Goodix GT9xx
	  touchscreen debug.

	  Say Y here if you want to have a Android app debug interface
	  to your system.

	  If unsure, say N.
```

## drivers/staging/prima/Kconfig
```kconfig
comment "Qualcomm Atheros Prima WLAN module"

config PRIMA_WLAN
	tristate "Qualcomm Atheros Prima WLAN module"
	default n
	help
	  Add support for the Qualcomm Atheros Prima WLAN module

config PRONTO_WLAN
	tristate "Qualcomm Atheros Pronto WLAN module"
	default n
	help
	  Add support for the Qualcomm Atheros Pronto WLAN module
```
